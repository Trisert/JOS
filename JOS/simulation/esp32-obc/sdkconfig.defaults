## JOS/simulation/esp32-obc/sdkconfig.defaults
```kconfig
CONFIG_IDF_TARGET="esp32"

CONFIG_FREERTOS_HZ=1000
CONFIG_FREERTOS_UNICORE=y

CONFIG_ESPTOOLPY_FLASHMODE_QIO=y
CONFIG_ESPTOOLPY_FLASHSIZE_4MB=y

CONFIG_COMPILER_OPTIMIZATION_SIZE=y

CONFIG_LOG_DEFAULT_LEVEL_INFO=y
CONFIG_LOG_MAXIMUM_LEVEL_DEBUG=y
```
